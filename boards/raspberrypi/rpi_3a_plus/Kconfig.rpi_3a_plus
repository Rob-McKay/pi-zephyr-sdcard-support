## boards/raspberrypi/rpi_3a_plus/Kconfig.rpi_3a_plus
```kconfig
# SPDX-License-Identifier: Apache-2.0

config BOARD_RPI_3A_PLUS
	select SOC_BCM2710
```

## boards/raspberrypi/rpi_3a_plus/board.yml
```yaml
# Copyright (c) 2026 Rob McKay
# SPDX-License-Identifier: Apache-2.0
board:
  name: rpi_3a_plus
  full_name: Raspberry Pi 3 Model A+
  vendor: raspberrypi
  socs:
  - name: bcm2710
```

## tests/hal_bcm2835/testcase.yaml
```yaml
# Copyright (c) 2026 Rob McKay
# SPDX-License-Identifier: Apache-2.0
tests:
  sdcard.hal_bcm2835:
    platform_allow: native_sim/native/64
    tags: hal
    harness: ztest
```

## tests/sd_bounds/testcase.yaml
```yaml
# Copyright (c) 2026 Rob McKay
# SPDX-License-Identifier: Apache-2.0
tests:
  sdcard.sd_bounds:
    platform_allow:
      - native_sim/native/64
    tags: sd
```

## tests/sd_bus_width/testcase.yaml
```yaml
tests:
  sdcard.sd_bus_width:
    platform_allow:
      - native_sim/native/64
    tags: sd
```

## tests/sdhost_review/testcase.yaml
```yaml
# Copyright (c) 2026 Rob McKay
# SPDX-License-Identifier: Apache-2.0
tests:
  sdcard.sdhost_review:
    platform_allow:
      - native_sim/native/64
    tags: sdhc review
```
