## CMakeLists.txt
```
# Copyright (c) 2026 Rob McKay
# SPDX-License-Identifier: Apache-2.0
#
# Reproduces the findings of docs/reviews/pr110196-sdhost-review.md: the
# PR's SDHost driver (applied to Zephyr by zephyr/patches.yml) and the
# BCM2711 pinctrl driver are compiled against fake register models.

cmake_minimum_required(VERSION 3.20.0)

include(${CMAKE_CURRENT_SOURCE_DIR}/../../cmake/toolchain.cmake)
find_package(Zephyr REQUIRED HINTS $ENV{ZEPHYR_BASE})
project(test_sdhost_review)

include(${CMAKE_CURRENT_SOURCE_DIR}/../../cmake/strict.cmake)
sd_strict_warnings(app)

set(sdhost_c ${ZEPHYR_BASE}/drivers/sdhc/sdhc_bcm2835_sdhost.c)
if(NOT EXISTS ${sdhost_c})
  message(FATAL_ERROR "${sdhost_c} not found: run 'west patch apply' (zephyr/patches.yml)")
endif()

target_sources(app PRIVATE src/sdhost.c src/pinctrl.c src/ubsan.c)
# Upstream sources #included by the tests: SYSTEM keeps them out of our
# warning policy.
target_include_directories(app SYSTEM PRIVATE
  ${ZEPHYR_BASE}/drivers/sdhc
  ${ZEPHYR_BASE}/drivers/pinctrl
  ${ZEPHYR_BASE}/soc/brcm/common)

# Finding 5: catch signed overflow in the driver. Handlers in ubsan.c record
# where it happened, so no sanitizer runtime is linked.
set_source_files_properties(src/sdhost.c PROPERTIES
  COMPILE_OPTIONS "-fsanitize=signed-integer-overflow")
```

## prj.conf
```kconfig
# Copyright (c) 2026 Rob McKay
# SPDX-License-Identifier: Apache-2.0
CONFIG_ZTEST=y
CONFIG_ZTEST_STACK_SIZE=16384
# The test thread must be preemptible to show starvation (finding 6) and
# concurrent requests (finding 9); time slicing lets equal priorities
# interleave.
CONFIG_ZTEST_THREAD_PRIORITY=1
CONFIG_TIMESLICING=y
CONFIG_TIMESLICE_SIZE=1
CONFIG_TIMESLICE_PRIORITY=0
CONFIG_SYS_CLOCK_TICKS_PER_SEC=10000
# For CONFIG_SDHC_LOG_LEVEL and the SDHC types; no SDHC device is built
# (the drivers under test are compiled into the test itself).
CONFIG_SDHC=y
CONFIG_LOG=y
CONFIG_PINCTRL_BCM2711=n
```

## boards/native_sim_native_64.overlay
```dts
/*
 * Copyright (c) 2026 Rob McKay
 * SPDX-License-Identifier: Apache-2.0
 *
 * A BCM283x pin controller for pinctrl_bcm2711.c (compiled into the test
 * against a fake register block; the real driver is disabled in prj.conf).
 */

/ {
	fake_pinctrl: pin-controller@3f200000 {
		compatible = "brcm,bcm2711-pinctrl";
		reg = <0x3f200000 0xf4>;
		ngpios = <54>;
	};
};
```

## src/pinctrl.c
```c
/*
 * Copyright (c) 2026 Rob McKay
 * SPDX-License-Identifier: Apache-2.0
 *
 * Finding 7 of docs/reviews/pr110196-sdhost-review.md: the PR's SDHost pins
 * ask for pull-ups (bias-pull-up on CMD and DAT0-3), but Zephyr's BCM2711
 * pinctrl driver, which BCM2710 boards also use, programs the BCM2711 pull
 * registers (GPIO_PUP_PDN_CNTRL, 0xe4..0xf0). The Pi 3 family's SoCs (the
 * BCM2837, the 3A+'s BCM2837B0 and the Zero 2 W's RP3A0) have the older
 * GPPUD (0x94) + GPPUDCLK0/1 (0x98/0x9c) sequence instead, so the pulls
 * are never set there.
 *
 * pinctrl_bcm2711.c is compiled here against a fake GPIO block that logs
 * every register write.
 */

#include <zephyr/arch/cpu.h>
#include <zephyr/device.h>
#include <zephyr/drivers/pinctrl.h>
#include <zephyr/dt-bindings/pinctrl/bcm2711-pinctrl.h>
#include <zephyr/init.h>
#include <zephyr/sys/util.h>
#include <zephyr/ztest.h>

#define GPIO_BASE DT_REG_ADDR(DT_NODELABEL(fake_pinctrl))

/* The fake GPIO block and its write log: only the driver's register hooks
 * and before() change them; the tests read them.
 */
static uint32_t gpio_regs[0xf4 / 4];
static struct {
	uint32_t off, val;
} gpio_log[64];
static int gpio_nlog;

/**
 * @brief The driver's sys_read32(): read a fake GPIO register.
 *
 * @param addr Register address.
 * @return Register value.
 */
static uint32_t fake_gpio_read32(uintptr_t addr)
{
	uint32_t off = addr - GPIO_BASE;

	zassert_true((off < sizeof(gpio_regs)), "read outside the GPIO block: 0x%x", off);
	return gpio_regs[off / 4];
}

/**
 * @brief The driver's sys_write32(): write a fake GPIO register and log it.
 *
 * @param val Value written.
 * @param addr Register address.
 *
 * @par Global state
 * Changes @c gpio_regs, @c gpio_log and @c gpio_nlog.
 */
static void fake_gpio_write32(uint32_t val, uintptr_t addr)
{
	uint32_t off = addr - GPIO_BASE;

	zassert_true((off < sizeof(gpio_regs)), "write outside the GPIO block: 0x%x", off);
	gpio_regs[off / 4] = val;
	if (gpio_nlog < (int)ARRAY_SIZE(gpio_log)) {
		gpio_log[gpio_nlog].off = off;
		gpio_log[gpio_nlog].val = val;
		gpio_nlog++;
	}
}

#define sys_read32(addr)       fake_gpio_read32((uintptr_t)(addr))
#define sys_write32(val, addr) fake_gpio_write32((val), (uintptr_t)(addr))

/* The driver under test, as in the pinned Zephyr. */
#include "pinctrl_bcm2711.c" /* NOLINT(bugprone-suspicious-include): the upstream driver is the code under test, built in to reach its static functions */

#undef sys_read32
#undef sys_write32

/* BCM2837/BCM2837B0 legacy pull control (BCM2835 ARM Peripherals, section 6.1). */
#define GPPUD          0x94
#define GPPUDCLK1      0x9c
#define GPPUD_PULL_UP  2
#define BCM2711_PUPPDN 0xe4 /* first BCM2711-only pull register */

static const pinctrl_soc_pin_t sd_cmd_pin = {
	.pin = 49, .func = BCM2711_FSEL_ALT0, .pull = BCM2711_PULL_UP,
};

/**
 * @brief Clear the fake GPIO block and its write log before each test.
 *
 * @param f Unused fixture.
 *
 * @par Global state
 * Changes @c gpio_regs and @c gpio_nlog.
 */
static void before(void *f)
{
	ARG_UNUSED(f);
	memset(gpio_regs, 0, sizeof(gpio_regs));
	gpio_nlog = 0;
}

/**
 * @brief Tell whether the driver wrote a value to a register.
 *
 * @param off Register offset.
 * @param mask Bits compared.
 * @param val Expected value of those bits.
 * @return True if any logged write to @p off matches.
 */
static bool wrote(uint32_t off, uint32_t mask, uint32_t val)
{
	for (int i = 0; i < gpio_nlog; i++) {
		if (gpio_log[i].off == off && (gpio_log[i].val & mask) == val) {
			return true;
		}
	}
	return false;
}

/** @brief Function select for GPIO 49 = ALT0 lands in GPFSEL4 bits 27-29. */
ZTEST(pinctrl_sanity, test_function_select)
{
	zassert_ok(pinctrl_configure_pins(&sd_cmd_pin, 1, 0));
	zassert_equal(((gpio_regs[0x10 / 4] >> 27) & 0x7), BCM2711_FSEL_ALT0);
}

ZTEST_SUITE(pinctrl_sanity, NULL, NULL, before, NULL, NULL);

/** @brief Finding 7: a pull-up uses the BCM2837's GPPUD/GPPUDCLK registers. */
ZTEST(pinctrl_review, test_f7_pull_up_uses_bcm2837_registers)
{
	zassert_ok(pinctrl_configure_pins(&sd_cmd_pin, 1, 0));

	for (int i = 0; i < gpio_nlog; i++) {
		zassert_true((gpio_log[i].off < BCM2711_PUPPDN),
			     "write to 0x%x, a BCM2711-only pull register (no such register on "
			     "the BCM2837)",
			     gpio_log[i].off);
	}
	zassert_true(wrote(GPPUD, 0x3, GPPUD_PULL_UP), "GPPUD never set to pull-up");
	zassert_true(wrote(GPPUDCLK1, BIT((49 - 32)), BIT((49 - 32))), "GPPUDCLK1 never clocked");
}

ZTEST_EXPECT_FAIL(pinctrl_review, test_f7_pull_up_uses_bcm2837_registers);

ZTEST_SUITE(pinctrl_review, NULL, NULL, before, NULL, NULL);
```

## src/ubsan.c
```c
/*
 * Copyright (c) 2026 Rob McKay
 * SPDX-License-Identifier: Apache-2.0
 *
 * Minimal handlers for -fsanitize=signed-integer-overflow (sdhost.c is
 * built with it). Instead of a sanitizer runtime, they count overflows
 * whose source location is in the driver under test, so a test can assert
 * there were none.
 */

#include <stdint.h>
#include <string.h>

#include "ubsan.h"

struct source_location {
	const char *file;
	uint32_t line;
	uint32_t column;
};

/* The UBSan runtime ABI's layout for overflow checks (GCC and clang):
 * the location comes first.
 */
struct overflow_data {
	struct source_location loc;
	const void *type;
};

int ubsan_driver_overflows;
uint32_t ubsan_last_line;

/* Interface: ubsan.h.
 * Global state: changes ubsan_driver_overflows and ubsan_last_line.
 */
void ubsan_reset(void)
{
	ubsan_driver_overflows = 0;
	ubsan_last_line = 0;
}

/**
 * @brief Count an overflow if it is in the driver under test.
 *
 * @param data The compiler's struct overflow_data for the check.
 *
 * @par Global state
 * Changes @c ubsan_driver_overflows and @c ubsan_last_line.
 */
static void record(void *data)
{
	const struct overflow_data *d = data;

	if (d->loc.file != NULL && strstr(d->loc.file, "sdhc_bcm2835_sdhost.c") != NULL) {
		ubsan_driver_overflows++;
		ubsan_last_line = d->loc.line;
	}
}

/* Interface: ubsan.h. */
void __ubsan_handle_add_overflow(void *data, void *lhs, void *rhs)
{
	(void)lhs;
	(void)rhs;
	record(data);
}

/* Interface: ubsan.h. */
void __ubsan_handle_sub_overflow(void *data, void *lhs, void *rhs)
{
	(void)lhs;
	(void)rhs;
	record(data);
}

/* Interface: ubsan.h. */
void __ubsan_handle_mul_overflow(void *data, void *lhs, void *rhs)
{
	(void)lhs;
	(void)rhs;
	record(data);
}

/* Interface: ubsan.h. */
void __ubsan_handle_negate_overflow(void *data, void *val)
{
	(void)val;
	record(data);
}

/* Interface: ubsan.h. */
void __ubsan_handle_divrem_overflow(void *data, void *lhs, void *rhs)
{
	(void)lhs;
	(void)rhs;
	record(data);
}
```

## src/ubsan.h
```c
/*
 * Copyright (c) 2026 Rob McKay
 * SPDX-License-Identifier: Apache-2.0
 */

#ifndef UBSAN_H_
#define UBSAN_H_

#include <stdint.h>

/* Signed overflows detected in sdhc_bcm2835_sdhost.c, and the last line.
 * Only the handlers below and ubsan_reset() change them.
 */
extern int ubsan_driver_overflows;
extern uint32_t ubsan_last_line;

/**
 * @brief Forget the overflows recorded so far.
 *
 * @par Global state
 * Changes @c ubsan_driver_overflows and @c ubsan_last_line.
 */
void ubsan_reset(void);

/**
 * @brief Sanitizer handler for a signed addition overflow: record it.
 *
 * @param data Check data, starting with the source location.
 * @param lhs Left operand (unused).
 * @param rhs Right operand (unused).
 */
void __ubsan_handle_add_overflow(void *data, void *lhs, void *rhs); /* NOLINT(bugprone-reserved-identifier,cert-dcl37-c,cert-dcl51-cpp): name fixed by the compiler's sanitizer ABI */

/**
 * @brief Sanitizer handler for a signed subtraction overflow: record it.
 *
 * @param data Check data, starting with the source location.
 * @param lhs Left operand (unused).
 * @param rhs Right operand (unused).
 */
void __ubsan_handle_sub_overflow(void *data, void *lhs, void *rhs); /* NOLINT(bugprone-reserved-identifier,cert-dcl37-c,cert-dcl51-cpp): name fixed by the compiler's sanitizer ABI */

/**
 * @brief Sanitizer handler for a signed multiplication overflow: record it.
 *
 * @param data Check data, starting with the source location.
 * @param lhs Left operand (unused).
 * @param rhs Right operand (unused).
 */
void __ubsan_handle_mul_overflow(void *data, void *lhs, void *rhs); /* NOLINT(bugprone-reserved-identifier,cert-dcl37-c,cert-dcl51-cpp): name fixed by the compiler's sanitizer ABI */

/**
 * @brief Sanitizer handler for a signed negation overflow: record it.
 *
 * @param data Check data, starting with the source location.
 * @param val Operand (unused).
 */
void __ubsan_handle_negate_overflow(void *data, void *val); /* NOLINT(bugprone-reserved-identifier,cert-dcl37-c,cert-dcl51-cpp): name fixed by the compiler's sanitizer ABI */

/**
 * @brief Sanitizer handler for a signed division or remainder overflow: record it.
 *
 * @param data Check data, starting with the source location.
 * @param lhs Left operand (unused).
 * @param rhs Right operand (unused).
 */
void __ubsan_handle_divrem_overflow(void *data, void *lhs, void *rhs); /* NOLINT(bugprone-reserved-identifier,cert-dcl37-c,cert-dcl51-cpp): name fixed by the compiler's sanitizer ABI */

#endif /* UBSAN_H_ */
```
