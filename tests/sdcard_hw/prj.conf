## CMakeLists.txt
```
# Copyright (c) 2026 Rob McKay
# SPDX-License-Identifier: Apache-2.0
#
# SD card qualification on a real Raspberry Pi 3A+: the SDHost driver from
# Zephyr PR #110196 (applied by zephyr/patches.yml) driven through Zephyr's
# disk access API, as an application or file system would use it. Build
# and package with scripts/sd-qual-test.sh ("make sd-qual-test").

cmake_minimum_required(VERSION 3.20.0)

include(${CMAKE_CURRENT_SOURCE_DIR}/../../cmake/toolchain.cmake)
find_package(Zephyr REQUIRED HINTS $ENV{ZEPHYR_BASE})
project(test_sdcard_hw)

include(${CMAKE_CURRENT_SOURCE_DIR}/../../cmake/strict.cmake)
sd_strict_warnings(app)

if(NOT TARGET drivers__sdhc)
  message(FATAL_ERROR "no SDHC driver library: is zephyr/patches.yml applied ('west patch apply')?")
endif()

target_sources(app PRIVATE
  src/common.c
  src/test_1_identify.c
  src/test_2_bootfs.c
  src/test_3_integrity.c
  src/test_4_bounds.c
  src/test_5_erase.c
  src/test_6_perf.c
  src/test_7_concurrency.c
  src/test_8_recovery.c
  src/test_9_soak.c
  ../sdhost_review/src/ubsan.c
)
target_include_directories(app PRIVATE ../sdhost_review/src ../../hal/include)

# Catch signed overflow in the driver as built into the image; ubsan.c
# records where it happened, and every test checks the count.
target_compile_options(drivers__sdhc PRIVATE -fsanitize=signed-integer-overflow)
```

## Kconfig
```
# Copyright (c) 2026 Rob McKay
# SPDX-License-Identifier: Apache-2.0

config SDCARD_HW_SCRATCH_MB
	int "Scratch area at the end of the card, in MB"
	default 64
	range 64 1024
	help
	  The write tests use only the last this-many megabytes of the card,
	  and only if no MBR partition reaches them. The card must be at least
	  twice this size.

config SDCARD_HW_SOAK_SECONDS
	int "Soak test duration, in seconds"
	default 600
	help
	  How long the random read/write/verify workload of the last suite
	  runs. 0 skips it.

config SDCARD_HW_SEED
	int "Random seed (0: from the clock)"
	default 0
	help
	  Seed for the random block addresses and sizes. Each run prints the
	  seed it used; set it here to repeat a failing run exactly.

config SDCARD_HW_ON_QEMU
	bool "Built for QEMU's raspi3ap (smoke test)"
	help
	  QEMU models the SDHost's data path but not its clock, timeout or
	  bus width registers: the tests that read those are skipped.

source "Kconfig.zephyr"
```

## prj.conf
```kconfig
# Copyright (c) 2026 Rob McKay
# SPDX-License-Identifier: Apache-2.0
CONFIG_ZTEST=y
CONFIG_ZTEST_STACK_SIZE=16384
# Preemptible test thread, time slicing: the concurrency suite runs
# several threads at the test thread's priority.
CONFIG_ZTEST_THREAD_PRIORITY=1
CONFIG_TIMESLICING=y
CONFIG_TIMESLICE_SIZE=1
CONFIG_TIMESLICE_PRIORITY=0
CONFIG_SYS_CLOCK_TICKS_PER_SEC=10000
# The card through Zephyr's disk access API ("SD"), as an application or a
# file system would use it.
CONFIG_SDHC=y
CONFIG_SDMMC_STACK=y
CONFIG_DISK_ACCESS=y
CONFIG_DISK_DRIVER_SDMMC=y
# crc32_ieee() for the boot partition's files.
CONFIG_CRC=y
CONFIG_LOG=y
CONFIG_LOG_MODE_IMMEDIATE=y
```

## src/common.c
```c
/*
 * Copyright (c) 2026 Rob McKay
 * SPDX-License-Identifier: Apache-2.0
 *
 * Shared state and helpers of the SD card qualification suites.
 */

#include "common.h"

#include <string.h>

#include <zephyr/device.h>
#include <zephyr/drivers/disk.h>
#include <zephyr/storage/disk_access.h>
#include <zephyr/sys/byteorder.h>
#include <zephyr/sys/device_mmio.h>
#include <zephyr/ztest.h>

#include <hal/bcm2835_sdhost.h>
#include <rpi_fw.h>

#include "ubsan.h"

#define TAG           0x5d0c5d0cU
#define FW_CLOCK_CORE 4

static const struct device *const fw = DEVICE_DT_GET(DT_NODELABEL(firmware));

/* The card and buffers every suite shares: their fixture (common.h). */
static struct sdq sdq = {.why = "not checked"};

/**
 * @brief Pattern word @p i of block @p lba, generation @p gen.
 *
 * @param lba Block number.
 * @param gen Generation.
 * @param i Word index, 3 to 127.
 * @return The word.
 */
static uint32_t pattern_word(uint32_t lba, uint32_t gen, uint32_t i)
{
	uint32_t x = (lba * 0x9e3779b1U) ^ (gen * 0x85ebca6bU) ^ (i * 0xc2b2ae35U);

	x ^= x >> 16;
	x *= 0x7feb352dU;
	x ^= x >> 15;
	return x;
}

/* Interface: common.h. */
void sdq_fill(uint8_t *p, uint32_t lba, uint32_t blocks, uint32_t gen)
{
	for (uint32_t b = 0; b < blocks; b++) {
		uint8_t *blk = p + ((size_t)b * SDQ_BLK);

		sys_put_le32(TAG, blk);
		sys_put_le32(lba + b, blk + 4);
		sys_put_le32(gen, blk + 8);
		for (uint32_t i = 3; i < SDQ_BLK / 4U; i++) {
			sys_put_le32(pattern_word(lba + b, gen, i), blk + ((size_t)i * 4U));
		}
	}
}

/* Interface: common.h. */
bool sdq_block_is(const uint8_t *p, uint8_t value)
{
	for (size_t i = 0; i < SDQ_BLK; i++) {
		if (p[i] != value) {
			return false;
		}
	}
	return true;
}

/**
 * @brief Find the first word of a block that differs from its pattern.
 *
 * Computes each expected word rather than filling a buffer, so several
 * threads can check at once.
 *
 * @param p The block.
 * @param lba Block number expected.
 * @param gen Generation expected.
 * @return Index of the first bad word, or SDQ_BLK / 4 if all match.
 */
static uint32_t first_bad_word(const uint8_t *p, uint32_t lba, uint32_t gen)
{
	const uint32_t head[3] = {TAG, lba, gen};

	for (uint32_t i = 0; i < SDQ_BLK / 4U; i++) {
		uint32_t want = i < 3U ? head[i] : pattern_word(lba, gen, i);

		if (sys_get_le32(p + ((size_t)i * 4U)) != want) {
			return i;
		}
	}
	return SDQ_BLK / 4U;
}

/**
 * @brief Print what a bad block holds instead of the expected pattern.
 *
 * @param p The block.
 * @param lba Block number expected.
 * @param gen Generation expected.
 */
static void describe_bad(const uint8_t *p, uint32_t lba, uint32_t gen)
{
	size_t off = (size_t)first_bad_word(p, lba, gen) * 4U;

	if (sys_get_le32(p) == TAG) {
		TC_PRINT("block %u: holds block %u generation %u (expected generation %u), "
			 "first difference at byte %zu\n",
			 lba, sys_get_le32(p + 4), sys_get_le32(p + 8), gen, off);
	} else if (sdq_block_is(p, 0x00) || sdq_block_is(p, 0xff)) {
		TC_PRINT("block %u: erased (all 0x%02x)\n", lba, p[0]);
	} else {
		TC_PRINT("block %u: unknown data, first word 0x%08x, first difference at byte %zu\n",
			 lba, sys_get_le32(p), off);
	}
}

/* Interface: common.h. */
int sdq_check(const uint8_t *p, uint32_t lba, uint32_t blocks, uint32_t gen)
{
	for (uint32_t b = 0; b < blocks; b++) {
		const uint8_t *blk = p + ((size_t)b * SDQ_BLK);

		if (first_bad_word(blk, lba + b, gen) < SDQ_BLK / 4U) {
			describe_bad(blk, lba + b, gen);
			return (int)b;
		}
	}
	return -1;
}

/* Interface: common.h. */
void sdq_write_verify(struct sdq *q, uint32_t lba, uint32_t blocks, uint32_t gen)
{
	sdq_fill(q->wbuf, lba, blocks, gen);
	zassert_ok(disk_access_write(SDQ_DISK, q->wbuf, lba, blocks), "write %u+%u", lba, blocks);
	memset(q->rbuf, 0xa5, (size_t)blocks * SDQ_BLK);
	zassert_ok(disk_access_read(SDQ_DISK, q->rbuf, lba, blocks), "read %u+%u", lba, blocks);
	zassert_equal(sdq_check(q->rbuf, lba, blocks, gen), -1, "data of %u+%u", lba, blocks);
}

/* Interface: common.h. */
uint32_t sdq_rand(uint32_t *state)
{
	uint32_t x = *state;

	x ^= x << 13;
	x ^= x >> 17;
	x ^= x << 5;
	*state = x;
	return x;
}

/* Interface: common.h. */
uint64_t sdq_now_us(void)
{
	return k_ticks_to_us_floor64((uint64_t)k_uptime_ticks());
}

/* Interface: common.h. */
uint32_t sdq_kbps(uint64_t bytes, uint64_t us)
{
	return us == 0U ? 0U : (uint32_t)((bytes * 1000U) / us);
}

/* Interface: common.h. */
uint32_t sdq_core_clock_hz(void)
{
	uint32_t req[2] = {FW_CLOCK_CORE, 0};

	if (!device_is_ready(fw) ||
	    rpi_fw_transfer(fw, RPI_FW_TAG_GET_CLOCK_RATE, req, sizeof(req)) != 0) {
		return 0;
	}
	return req[1];
}

/**
 * @brief Check that the scratch area lies in free clusters of a FAT32
 *        partition, by reading its boot sector and FAT a block at a time.
 *
 * Writing there changes no file: FAT32 never reads a free cluster.
 *
 * @param[in,out] q The card; its spare block is used.
 * @param e The partition's MBR entry.
 * @return NULL if every cluster the scratch area touches is free, else why not.
 */
static const char *fat_scratch_free(struct sdq *q, const uint8_t *e)
{
	uint8_t *blk = q->blk;
	uint32_t start = sys_get_le32(e + 8);
	uint32_t end = start + sys_get_le32(e + 12) - 1U; /* last block */
	uint32_t fat;
	uint32_t data;
	uint32_t spc;
	uint32_t clusters;
	uint32_t first;
	uint32_t last;
	uint32_t loaded = UINT32_MAX;

	if (e[4] != 0x0bU && e[4] != 0x0cU) {
		return "a partition that isn't FAT32 reaches the scratch area at the end of the card";
	}
	if (disk_access_read(SDQ_DISK, blk, start, 1) != 0 || blk[510] != 0x55U ||
	    blk[511] != 0xaaU || sys_get_le16(&blk[11]) != SDQ_BLK || blk[13] == 0U ||
	    blk[16] == 0U || sys_get_le32(&blk[36]) == 0U) {
		return "the FAT32 partition reaching the scratch area has no usable boot sector";
	}
	spc = blk[13];
	fat = start + sys_get_le16(&blk[14]);
	data = fat + (blk[16] * sys_get_le32(&blk[36]));
	clusters = (sys_get_le32(&blk[32]) - (data - start)) / spc;
	if (q->scratch < data) {
		return "the scratch area would overlap the FAT32 partition's tables";
	}
	/* Blocks past the last whole cluster, up to the partition's end, are
	 * slack no file uses.
	 */
	first = 2U + ((q->scratch - data) / spc);
	last = MIN((2U + ((MIN(end, (q->sectors - 1U)) - data) / spc)), (clusters + 1U));
	for (uint32_t c = first; c <= last; c++) {
		uint32_t lba = fat + ((c * 4U) / SDQ_BLK);

		if (lba != loaded) {
			if (disk_access_read(SDQ_DISK, blk, lba, 1) != 0) {
				return "the FAT could not be read";
			}
			loaded = lba;
		}
		if ((sys_get_le32(&blk[(c * 4U) % SDQ_BLK]) & 0x0fffffffU) != 0U) {
			return "the FAT32 partition has files in the scratch area at the end of the card";
		}
	}
	TC_PRINT("scratch area lies in free clusters %u-%u of FAT32 partition at block %u\n",
		 first, last, start);
	return NULL;
}

/**
 * @brief Check the MBR's partitions against the scratch area: none may
 *        reach it, except a FAT32 partition whose clusters there are free.
 *
 * @param[in,out] q The card.
 * @param mbr Block 0, with a valid MBR signature.
 * @return NULL if the scratch area may be written, else why not.
 */
static const char *check_partitions(struct sdq *q, const uint8_t *mbr)
{
	for (size_t i = 0; i < 4U; i++) {
		const uint8_t *e = &mbr[446U + (i * 16U)];
		uint32_t start = sys_get_le32(e + 8);
		uint32_t count = sys_get_le32(e + 12);
		const char *why;

		if (e[4] == 0U || count == 0U || (uint64_t)start + count <= q->scratch) {
			continue;
		}
		why = fat_scratch_free(q, e);
		if (why != NULL) {
			return why;
		}
	}
	return NULL;
}

/**
 * @brief Decide whether the scratch area may be written: if no MBR
 *        partition uses it, or, without an MBR, if block 0 is blank.
 *
 * @param[in,out] q The card.
 */
static void check_scratch(struct sdq *q)
{
	const char *why;

	q->scratch_ok = false;
	if (q->sectors < 2U * SDQ_SCRATCH_BLOCKS) {
		q->why = "card smaller than twice CONFIG_SDCARD_HW_SCRATCH_MB";
		return;
	}
	q->scratch = q->sectors - SDQ_SCRATCH_BLOCKS;
	if (q->block0[510] != 0x55U || q->block0[511] != 0xaaU) {
		if (!sdq_block_is(q->block0, 0x00)) {
			q->why = "no MBR, and block 0 is not blank";
			return;
		}
	} else {
		why = check_partitions(q, q->block0);
		if (why != NULL) {
			q->why = why;
			return;
		}
	}
	q->scratch_ok = true;
}

/**
 * @brief Print the card, bus and scratch area, once.
 *
 * @param q The card.
 */
static void print_setup(const struct sdq *q)
{
	uintptr_t regs = q->sdhost;
	uint32_t core = sdq_core_clock_hz();
	uint32_t div = hal_sdhost_clock_divider(regs);

	TC_PRINT("card: %u blocks of %u bytes (%u MB)\n", q->sectors, q->sector_size,
		 (q->sectors / 2048U));
	TC_PRINT("bus: %s, core clock %u Hz / (SDCDIV %u + 2) = %u Hz\n",
		 (hal_sdhost_bus_is_4bit(regs) ? "4-bit" : "1-bit"), core, div,
		 (core / (div + 2U)));
	if (q->scratch_ok) {
		TC_PRINT("scratch area: blocks %u-%u (%u MB, written by these tests)\n", q->scratch,
			 (q->sectors - 1U), (uint32_t)CONFIG_SDCARD_HW_SCRATCH_MB);
	} else {
		TC_PRINT("no scratch area (%s): the write tests are skipped\n", q->why);
		for (size_t i = 0; i < 4U; i++) {
			const uint8_t *e = &q->block0[446U + (i * 16U)];

			if (e[4] != 0U) {
				TC_PRINT("  partition %zu: type 0x%02x, blocks %u-%u\n", (i + 1U),
					 e[4], sys_get_le32(e + 8),
					 (sys_get_le32(e + 8) + sys_get_le32(e + 12) - 1U));
			}
		}
	}
	TC_PRINT("random seed: %u (CONFIG_SDCARD_HW_SEED repeats it)\n", q->seed);
}

/* Interface: common.h.
 * Global state: changes sdq.
 */
void *sdq_setup(void)
{
	struct sdq *q = &sdq;

	if (q->ready) {
		return q;
	}
	device_map(&q->sdhost, DT_REG_ADDR(DT_NODELABEL(sdhost)), DT_REG_SIZE(DT_NODELABEL(sdhost)),
		   K_MEM_CACHE_NONE);
	zassert_ok(disk_access_init(SDQ_DISK), "no card, or card init failed");
	zassert_ok(disk_access_ioctl(SDQ_DISK, DISK_IOCTL_GET_SECTOR_COUNT, &q->sectors));
	zassert_ok(disk_access_ioctl(SDQ_DISK, DISK_IOCTL_GET_SECTOR_SIZE, &q->sector_size));
	zassert_ok(disk_access_read(SDQ_DISK, q->block0, 0, 1), "block 0 unreadable");
	check_scratch(q);
	q->seed = CONFIG_SDCARD_HW_SEED != 0 ? (uint32_t)CONFIG_SDCARD_HW_SEED
					     : (k_cycle_get_32() | 1U);
	print_setup(q);
	q->ready = true;
	return q;
}

/* Interface: common.h. */
void sdq_need_scratch(const struct sdq *q)
{
	if (!q->scratch_ok) {
		ztest_test_skip();
	}
}

/**
 * @brief Tell whether the card answers correctly: status OK and block 0
 *        reads back as it did at setup.
 *
 * @param[in,out] q The card; its spare block is used.
 * @return True if healthy.
 */
static bool card_healthy(struct sdq *q)
{
	return disk_access_status(SDQ_DISK) == DISK_STATUS_OK &&
	       disk_access_read(SDQ_DISK, q->blk, 0, 1) == 0 &&
	       memcmp(q->blk, q->block0, SDQ_BLK) == 0;
}

/**
 * @brief Power the card off and initialise it again through the disk API.
 *
 * @return 0, or the error of the re-init.
 */
static int power_cycle(void)
{
	(void)disk_access_ioctl(SDQ_DISK, DISK_IOCTL_CTRL_DEINIT, NULL);
	k_msleep(10);
	return disk_access_ioctl(SDQ_DISK, DISK_IOCTL_CTRL_INIT, NULL);
}

/**
 * @brief Empty the controller's FIFO, which no driver path does (review
 *        finding 2): the last resort when a power cycle didn't help.
 *
 * @param q The card.
 * @return Words removed.
 */
static int drain_fifo(const struct sdq *q)
{
	uintptr_t regs = q->sdhost;
	int words = 0;

	while (hal_sdhost_fifo_level(regs) != 0U && words < 4096) {
		(void)hal_sdhost_fifo_read(regs);
		words++;
	}
	return words;
}

/* Interface: common.h. */
void sdq_before(void *f)
{
	struct sdq *q = f;
	int ret;

	ubsan_reset();
	if (card_healthy(q)) {
		return;
	}
	q->recoveries++;
	TC_PRINT("RECOVERY: the card did not answer correctly after the previous test; "
		 "power cycling it through the disk API\n");
	ret = power_cycle();
	if (ret == 0 && card_healthy(q)) {
		return;
	}
	TC_PRINT("RECOVERY: re-init gave %d; emptying %d stale FIFO words and retrying\n", ret,
		 drain_fifo(q));
	ret = power_cycle();
	if (ret != 0 || !card_healthy(q)) {
		/* Not an assertion: ztest reports a failure in before() as a
		 * skip, which would hide it. The test runs, and fails on the
		 * card itself.
		 */
		q->recovery_failures++;
		TC_PRINT("RECOVERY FAILED (%d): the card is still unusable; this test will fail "
			 "too\n",
			 ret);
	}
}

/* Interface: common.h. */
void sdq_after(void *f)
{
	ARG_UNUSED(f);
	zassert_equal(ubsan_driver_overflows, 0,
		      "signed integer overflow in the driver (%d, last at line %u)",
		      ubsan_driver_overflows, ubsan_last_line);
}
```

## src/common.h
```c
/*
 * Copyright (c) 2026 Rob McKay
 * SPDX-License-Identifier: Apache-2.0
 *
 * Shared state and helpers of the SD card qualification suites: the disk,
 * the scratch area the write tests may use, pattern blocks that say which
 * block and which write they came from, buffers, timing and a seeded
 * random generator.
 */

#ifndef SDCARD_HW_COMMON_H_
#define SDCARD_HW_COMMON_H_

#include <stdbool.h>
#include <stddef.h>
#include <stdint.h>

#include <zephyr/kernel.h>

/** The card's disk name (board devicetree, sdmmc node). */
#define SDQ_DISK "SD"

/** Block size: every SD card since SDHC uses 512 bytes. */
#define SDQ_BLK 512U

/** Largest transfer the tests make: 1 MB. */
#define SDQ_MAX_BLOCKS 2048U

/** Blocks in the scratch area. */
#define SDQ_SCRATCH_BLOCKS ((uint32_t)CONFIG_SDCARD_HW_SCRATCH_MB * 2048U)

/**
 * What the suites know about the card, and the buffers they share: the
 * fixture sdq_setup() gives every suite.
 *
 * A suite with no state of its own uses it as its fixture type, with
 * "#define <suite>_fixture sdq" ahead of its tests; one with state of its
 * own has a fixture holding a pointer to it, and calls sdq_before() and
 * sdq_after() with that pointer.
 */
struct sdq {
	uint32_t sectors;     /**< capacity in blocks */
	uint32_t sector_size; /**< block size the disk reports */
	uint32_t scratch;     /**< first block of the scratch area */
	uint32_t seed;        /**< random seed of this run */
	uint32_t recoveries;  /**< times a test found the card unusable */
	uint32_t recovery_failures; /**< times recovering it didn't work */
	const char *why;            /**< why the scratch area can't be written, if not */
	uintptr_t sdhost;           /**< the SDHost registers, mapped */
	bool scratch_ok;            /**< the write tests may use the scratch area */
	bool ready;                 /**< set up */

	/** Block 0 as read at setup: the health check compares against it. */
	uint8_t block0[SDQ_BLK] __aligned(4);
	/** A block for setup and the health check to read into. */
	uint8_t blk[SDQ_BLK] __aligned(4);
	/** Write and read buffers, SDQ_MAX_BLOCKS blocks plus room to misalign. */
	uint8_t wbuf[(SDQ_MAX_BLOCKS * SDQ_BLK) + 64] __aligned(64);
	uint8_t rbuf[(SDQ_MAX_BLOCKS * SDQ_BLK) + 64] __aligned(64);
};

/**
 * @brief Suite setup shared by every suite: initialise the disk and, once,
 *        decide whether the scratch area may be written.
 *
 * @return The shared struct sdq.
 *
 * @par Global state
 * Changes the shared struct sdq (common.c's @c sdq).
 */
void *sdq_setup(void);

/**
 * @brief Per-test setup: check the card still answers, recovering it
 *        (power cycle and re-init) if a previous test left it unusable.
 *
 * Never fails: ztest would report the test as skipped. If recovery
 * doesn't work, it says so and the test fails on the card.
 *
 * @param f The struct sdq.
 */
void sdq_before(void *f);

/**
 * @brief Per-test teardown: fail if the driver overflowed a signed integer.
 *
 * @param f Unused fixture.
 */
void sdq_after(void *f);

/**
 * @brief Skip the test unless the scratch area may be written.
 *
 * @param q The card.
 */
void sdq_need_scratch(const struct sdq *q);

/**
 * @brief Fill blocks with pattern data.
 *
 * Each block holds a tag, its own block number, a generation number and
 * data derived from both, so a block read from the wrong place, or an
 * older write of the right place, is recognised.
 *
 * @param[out] p Buffer of @p blocks blocks (any alignment).
 * @param lba Block number of the first block.
 * @param blocks Block count.
 * @param gen Generation (write number).
 */
void sdq_fill(uint8_t *p, uint32_t lba, uint32_t blocks, uint32_t gen);

/**
 * @brief Check blocks against the pattern they should hold.
 *
 * Prints what the first bad block holds instead (another block's data,
 * an older generation, erased or unknown data). Safe to call from several
 * threads at once.
 *
 * @param p Buffer of @p blocks blocks.
 * @param lba Block number of the first block.
 * @param blocks Block count.
 * @param gen Generation expected.
 * @retval -1 All blocks match.
 * @return Otherwise the index of the first bad block.
 */
int sdq_check(const uint8_t *p, uint32_t lba, uint32_t blocks, uint32_t gen);

/**
 * @brief Write and read back blocks of the scratch area through the disk
 *        API, asserting both succeed and the data matches.
 *
 * @param[in,out] q The card; its buffers are used.
 * @param lba First block.
 * @param blocks Block count, at most SDQ_MAX_BLOCKS.
 * @param gen Generation to write.
 */
void sdq_write_verify(struct sdq *q, uint32_t lba, uint32_t blocks, uint32_t gen);

/**
 * @brief Next number from the run's random generator (xorshift32).
 *
 * @param[in,out] state Generator state, never 0.
 * @return Next number.
 */
uint32_t sdq_rand(uint32_t *state);

/**
 * @brief Microseconds since boot, in kernel ticks (100 us).
 *
 * @return Time in microseconds.
 */
uint64_t sdq_now_us(void);

/**
 * @brief Throughput in kB/s (1000 bytes) of a transfer.
 *
 * @param bytes Bytes moved.
 * @param us Time taken, in microseconds.
 * @return kB/s, or 0 for no time.
 */
uint32_t sdq_kbps(uint64_t bytes, uint64_t us);

/**
 * @brief Tell whether a block holds one byte value throughout.
 *
 * @param p One block.
 * @param value Byte value.
 * @return True if every byte is @p value.
 */
bool sdq_block_is(const uint8_t *p, uint8_t value);

/**
 * @brief Ask the firmware for the VPU core clock, the SDHost's input.
 *
 * @return Core clock in Hz, or 0 if the firmware didn't answer.
 */
uint32_t sdq_core_clock_hz(void);

#endif /* SDCARD_HW_COMMON_H_ */
```

## src/test_1_identify.c
```c
/*
 * Copyright (c) 2026 Rob McKay
 * SPDX-License-Identifier: Apache-2.0
 *
 * Suite 1: the card is found and initialised, and the controller runs the
 * bus as the SD specification allows.
 */

#include <zephyr/drivers/disk.h>
#include <zephyr/storage/disk_access.h>
#include <zephyr/ztest.h>

#include <hal/bcm2835_sdhost.h>

#include "common.h"

/* The suite's fixture is the shared card (common.h). */
#define sdcard_1_identify_fixture sdq

/* Default Speed allows 25 MHz, High Speed 50 MHz (SD Physical Layer
 * Specification, 4.3.10). The driver reports which it chose only through
 * the clock, so the test allows High Speed.
 */
#define HS_MAX_HZ 50000000U

/** @brief Skip a test that reads controller registers QEMU doesn't model. */
static void need_real_registers(void)
{
	if (IS_ENABLED(CONFIG_SDCARD_HW_ON_QEMU)) {
		TC_PRINT("QEMU doesn't model this register\n");
		ztest_test_skip();
	}
}

/** @brief The disk reports OK, 512-byte blocks and a plausible capacity. */
ZTEST_F(sdcard_1_identify, test_disk_ready)
{
	zassert_equal(disk_access_status(SDQ_DISK), DISK_STATUS_OK);
	zassert_equal(fixture->sector_size, SDQ_BLK, "block size %u", fixture->sector_size);
	/* Not the 64 MB card image's size: the whole card's. */
	zassert_true((fixture->sectors >= 131072U), "only %u blocks: is this the whole card?",
		     fixture->sectors);
}

/** @brief The SD bus is 4 bits wide, as every SD memory card supports. */
ZTEST_F(sdcard_1_identify, test_bus_4bit)
{
	need_real_registers();
	zassert_true(hal_sdhost_bus_is_4bit(fixture->sdhost),
		     "the driver left the bus 1 bit wide: a quarter of the speed");
}

/** @brief The bus clock, from the real core clock, is within the High Speed limit. */
ZTEST_F(sdcard_1_identify, test_bus_clock_in_spec)
{
	uint32_t core = sdq_core_clock_hz();
	uint32_t bus;

	need_real_registers();
	zassert_not_equal(core, 0, "firmware did not report the core clock");
	bus = core / (hal_sdhost_clock_divider(fixture->sdhost) + 2U);
	TC_PRINT("SD bus clock %u Hz\n", bus);
	zassert_true((bus <= HS_MAX_HZ), "bus clock %u Hz over 50 MHz (review finding 3)", bus);
	zassert_true((bus >= 400000U), "bus clock %u Hz: still at the identification rate", bus);
}

/** @brief The hardware data timeout lasts at least the 500 ms an SDXC write may take. */
ZTEST_F(sdcard_1_identify, test_data_timeout_covers_busy)
{
	uintptr_t regs = fixture->sdhost;
	uint32_t core = sdq_core_clock_hz();
	uint32_t bus = core / (hal_sdhost_clock_divider(regs) + 2U);
	uint32_t cycles = hal_sdhost_data_timeout(regs);
	uint64_t ms = bus == 0U ? 0U : ((uint64_t)cycles * 1000U) / bus;

	need_real_registers();
	TC_PRINT("SDTOUT %u cycles = %llu ms at %u Hz\n", cycles, ms, bus);
	zassert_true((ms >= 500U), "data timeout %llu ms < 500 ms (review finding 4)", ms);
}

/** @brief The erase block size and sync ioctls answer. */
ZTEST(sdcard_1_identify, test_ioctls)
{
	uint32_t erase = 0;

	zassert_ok(disk_access_ioctl(SDQ_DISK, DISK_IOCTL_GET_ERASE_BLOCK_SZ, &erase));
	zassert_true((erase >= 1U), "erase block size %u", erase);
	zassert_ok(disk_access_ioctl(SDQ_DISK, DISK_IOCTL_CTRL_SYNC, NULL));
}

ZTEST_SUITE(sdcard_1_identify, NULL, sdq_setup, sdq_before, sdq_after, NULL);
```

## src/test_2_bootfs.c
```c
/*
 * Copyright (c) 2026 Rob McKay
 * SPDX-License-Identifier: Apache-2.0
 *
 * Suite 2, read-only: the card's boot partition, as the Pi's firmware
 * wrote it, read through the driver. The FAT32 file system is walked by
 * hand (no file system library), and every file in its root directory is
 * read three ways: a cluster per request, a block per request, and into a
 * misaligned buffer. The three CRCs must agree, and zephyr.bin's must
 * match zephyr.crc, written to the card by the host
 * (scripts/sd-qual-test.sh). Runs on any card, written or not.
 */

#include <string.h>

#include <zephyr/storage/disk_access.h>
#include <zephyr/sys/byteorder.h>
#include <zephyr/sys/crc.h>
#include <zephyr/ztest.h>

#include "common.h"

/* Directory entry attributes. */
#define ATTR_DIR 0x10U
#define ATTR_VOL 0x08U
#define ATTR_LFN 0x0fU

#define FAT_EOC  0x0ffffff8U
#define MAX_FILES 16

/** How a file is read. */
enum read_mode {
	BY_CLUSTER,    /**< one request per cluster */
	BY_BLOCK,      /**< one request per block */
	BY_MISALIGNED, /**< one per cluster, into a buffer at an odd address */
};

/** The partition's FAT32 layout. */
struct fat_layout {
	uint32_t part_start; /**< first block of the partition */
	uint32_t fat;        /**< first block of the first FAT */
	uint32_t data;       /**< first block of cluster 2 */
	uint32_t spc;        /**< blocks per cluster */
	uint32_t root;       /**< root directory's first cluster */
	uint32_t clusters;   /**< data clusters */
	bool ok;
};

/** A root directory file. */
struct file {
	char name[13];  /**< 8.3 name, e.g. "ZEPHYR.BIN" */
	uint32_t first; /**< first cluster */
	uint32_t size;  /**< bytes */
};

/** The suite's state: the shared card, and what was read of its boot partition. */
struct sdcard_2_bootfs_fixture {
	struct sdq *q;
	struct fat_layout fs;
	struct file files[MAX_FILES]; /**< the root directory's files */
	size_t nfiles;
	uint8_t blk[SDQ_BLK] __aligned(4); /**< one block, for the MBR, boot sector and FAT */
	char text[1024];                   /**< config.txt's start */
};

/**
 * @brief Read the MBR and the FAT32 boot sector into fs.
 *
 * @param[in,out] bf The suite's state.
 * @return 0, or a message saying what is wrong.
 */
static const char *read_layout(struct sdcard_2_bootfs_fixture *bf)
{
	const uint8_t *e = &bf->blk[446];
	uint32_t reserved;
	uint32_t fat_size;
	uint32_t total;

	if (disk_access_read(SDQ_DISK, bf->blk, 0, 1) != 0) {
		return "MBR read failed";
	}
	if (bf->blk[510] != 0x55U || bf->blk[511] != 0xaaU) {
		return "no MBR";
	}
	if (e[4] != 0x0bU && e[4] != 0x0cU) {
		return "partition 1 is not FAT32";
	}
	bf->fs.part_start = sys_get_le32(e + 8);
	if (disk_access_read(SDQ_DISK, bf->blk, bf->fs.part_start, 1) != 0) {
		return "boot sector read failed";
	}
	if (bf->blk[510] != 0x55U || bf->blk[511] != 0xaaU ||
	    sys_get_le16(&bf->blk[11]) != SDQ_BLK) {
		return "partition 1 has no FAT boot sector with 512-byte sectors";
	}
	bf->fs.spc = bf->blk[13];
	reserved = sys_get_le16(&bf->blk[14]);
	fat_size = sys_get_le32(&bf->blk[36]);
	total = sys_get_le32(&bf->blk[32]);
	bf->fs.root = sys_get_le32(&bf->blk[44]);
	if (bf->fs.spc == 0U || fat_size == 0U || bf->blk[16] == 0U) {
		return "boot sector fields are zero";
	}
	bf->fs.fat = bf->fs.part_start + reserved;
	bf->fs.data = bf->fs.fat + (bf->blk[16] * fat_size);
	bf->fs.clusters = (total - (bf->fs.data - bf->fs.part_start)) / bf->fs.spc;
	if (bf->fs.spc * SDQ_BLK > SDQ_MAX_BLOCKS * SDQ_BLK) {
		return "clusters larger than the test's buffer";
	}
	return NULL;
}

/**
 * @brief Follow the FAT from a cluster.
 *
 * @param[in,out] bf The suite's state.
 * @param cluster Cluster.
 * @param[out] next The next cluster, or FAT_EOC or more at the end.
 * @return 0, or the read's error.
 */
static int fat_next(struct sdcard_2_bootfs_fixture *bf, uint32_t cluster, uint32_t *next)
{
	uint32_t off = cluster * 4U;
	int ret = disk_access_read(SDQ_DISK, bf->blk, bf->fs.fat + (off / SDQ_BLK), 1);

	if (ret == 0) {
		*next = sys_get_le32(&bf->blk[off % SDQ_BLK]) & 0x0fffffffU;
	}
	return ret;
}

/**
 * @brief Tell whether a cluster number lies inside the data area.
 *
 * @param[in,out] bf The suite's state.
 * @param c Cluster.
 * @return True if valid.
 */
static bool cluster_valid(struct sdcard_2_bootfs_fixture *bf, uint32_t c)
{
	return c >= 2U && c < bf->fs.clusters + 2U;
}

/**
 * @brief First block of a cluster.
 *
 * @param[in,out] bf The suite's state.
 * @param c Cluster, at least 2.
 * @return Block number.
 */
static uint32_t cluster_lba(struct sdcard_2_bootfs_fixture *bf, uint32_t c)
{
	return bf->fs.data + ((c - 2U) * bf->fs.spc);
}

/**
 * @brief Make an 8.3 name ("CONFIG.TXT") from a directory entry.
 *
 * @param e Directory entry.
 * @param[out] out 13 bytes.
 */
static void short_name(const uint8_t *e, char *out)
{
	size_t n = 0;

	for (size_t i = 0; i < 8U && e[i] != ' '; i++) {
		out[n++] = (char)e[i];
	}
	if (e[8] != ' ') {
		out[n++] = '.';
		for (size_t i = 8; i < 11U && e[i] != ' '; i++) {
			out[n++] = (char)e[i];
		}
	}
	out[n] = '\0';
}

/**
 * @brief Collect the root directory's regular files into files[].
 *
 * @param[in,out] bf The suite's state.
 * @return 0, or a message saying what is wrong.
 */
static const char *read_root(struct sdcard_2_bootfs_fixture *bf)
{
	uint32_t c = bf->fs.root;
	int hops = 0;

	bf->nfiles = 0;
	while (cluster_valid(bf, c) && hops++ < 64) {
		if (disk_access_read(SDQ_DISK, bf->q->rbuf, cluster_lba(bf, c), bf->fs.spc) != 0) {
			return "root directory read failed";
		}
		for (uint32_t off = 0; off < bf->fs.spc * SDQ_BLK; off += 32U) {
			const uint8_t *e = &bf->q->rbuf[off];

			if (e[0] == 0U) {
				return NULL;
			}
			if (e[0] == 0xe5U || e[11] == ATTR_LFN ||
			    (e[11] & (ATTR_DIR | ATTR_VOL)) != 0U || bf->nfiles == MAX_FILES) {
				continue;
			}
			short_name(e, bf->files[bf->nfiles].name);
			bf->files[bf->nfiles].first =
				((uint32_t)sys_get_le16(&e[20]) << 16) | sys_get_le16(&e[26]);
			bf->files[bf->nfiles].size = sys_get_le32(&e[28]);
			bf->nfiles++;
		}
		if (fat_next(bf, c, &c) != 0) {
			return "FAT read failed";
		}
	}
	return NULL;
}

/**
 * @brief Read one cluster's worth of a file in the given way.
 *
 * @param[in,out] bf The suite's state.
 * @param c Cluster.
 * @param mode How.
 * @param[out] out Where the data starts.
 * @return 0, or the read's error.
 */
static int read_cluster(struct sdcard_2_bootfs_fixture *bf, uint32_t c, enum read_mode mode,
			const uint8_t **out)
{
	uint32_t lba = cluster_lba(bf, c);
	int ret = 0;

	switch (mode) {
	case BY_CLUSTER:
		ret = disk_access_read(SDQ_DISK, bf->q->rbuf, lba, bf->fs.spc);
		*out = bf->q->rbuf;
		break;
	case BY_BLOCK:
		for (uint32_t b = 0; b < bf->fs.spc && ret == 0; b++) {
			ret = disk_access_read(SDQ_DISK, &bf->q->rbuf[(size_t)b * SDQ_BLK], lba + b,
					       1);
		}
		*out = bf->q->rbuf;
		break;
	default:
		ret = disk_access_read(SDQ_DISK, &bf->q->rbuf[3], lba, bf->fs.spc);
		*out = &bf->q->rbuf[3];
		break;
	}
	return ret;
}

/**
 * @brief Read a whole file and give its CRC-32.
 *
 * @param[in,out] bf The suite's state.
 * @param f File.
 * @param mode How to read it.
 * @param[out] crc CRC-32 (as zlib's crc32()).
 * @param[out] head The first bytes, if not NULL.
 * @param head_len Size of @p head.
 * @return 0, or a negative errno: -EIO for a read error, -EBADF for a
 *         broken cluster chain.
 */
static int file_crc(struct sdcard_2_bootfs_fixture *bf, const struct file *f, enum read_mode mode,
		    uint32_t *crc, char *head, size_t head_len)
{
	uint32_t left;
	uint32_t c;
	uint32_t v = 0;
	bool first = true;

	if (f == NULL) {
		return -EINVAL;
	}
	left = f->size;
	c = f->first;

	while (left > 0U) {
		const uint8_t *p;
		uint32_t n = MIN(left, (bf->fs.spc * SDQ_BLK));

		if (!cluster_valid(bf, c)) {
			return -EBADF;
		}
		if (read_cluster(bf, c, mode, &p) != 0) {
			return -EIO;
		}
		if (first && head != NULL) {
			size_t h = MIN((size_t)n, (head_len - 1U));

			memcpy(head, p, h);
			head[h] = '\0';
		}
		first = false;
		v = crc32_ieee_update(v, p, n);
		left -= n;
		if (left > 0U && fat_next(bf, c, &c) != 0) {
			return -EIO;
		}
	}
	*crc = v;
	return 0;
}

/**
 * @brief Find a root directory file by its 8.3 name.
 *
 * @param[in,out] bf The suite's state.
 * @param name Name, e.g. "ZEPHYR.BIN".
 * @return The file, or NULL.
 */
static const struct file *find(struct sdcard_2_bootfs_fixture *bf, const char *name)
{
	for (size_t i = 0; i < bf->nfiles; i++) {
		if (strcmp(bf->files[i].name, name) == 0) {
			return &bf->files[i];
		}
	}
	return NULL;
}

/**
 * @brief Suite setup: the common setup, then the partition's layout and
 *        root directory.
 *
 * @return The fixture.
 *
 * @par Global state
 * Changes @c fixture.
 */
static void *bootfs_setup(void)
{
	static struct sdcard_2_bootfs_fixture fixture;
	struct sdcard_2_bootfs_fixture *bf = &fixture;
	const char *err;

	bf->q = sdq_setup();
	err = read_layout(bf);
	if (err == NULL) {
		err = read_root(bf);
	}
	bf->fs.ok = err == NULL;
	if (bf->fs.ok) {
		TC_PRINT("boot partition at block %u: %u blocks a cluster, %zu files\n",
			 bf->fs.part_start, bf->fs.spc, bf->nfiles);
	} else {
		TC_PRINT("boot partition not readable: %s\n", err);
	}
	return bf;
}

/**
 * @brief Before each test: check the card (sdq_before()).
 *
 * @param f The fixture.
 */
static void bootfs_before(void *f)
{
	sdq_before(((struct sdcard_2_bootfs_fixture *)f)->q);
}

/**
 * @brief After each test: check the driver (sdq_after()).
 *
 * @param f The fixture.
 */
static void bootfs_after(void *f)
{
	sdq_after(((struct sdcard_2_bootfs_fixture *)f)->q);
}

/** @brief The MBR and FAT32 boot sector of the card's first partition parse. */
ZTEST_F(sdcard_2_bootfs, test_1_layout)
{
	zassert_true(fixture->fs.ok, "the boot partition could not be read: see above");
	zassert_not_null(find(fixture, "ZEPHYR.BIN"), "no zephyr.bin in the root directory");
	zassert_not_null(find(fixture, "CONFIG.TXT"), "no config.txt in the root directory");
}

/** @brief config.txt reads back as the text the firmware booted from. */
ZTEST_F(sdcard_2_bootfs, test_2_config_txt)
{
	const struct file *f = find(fixture, "CONFIG.TXT");
	char *text = fixture->text;
	uint32_t crc;

	zassert_not_null(f);
	zassert_ok(file_crc(fixture, f, BY_CLUSTER, &crc, text, sizeof(fixture->text)));
	zassert_not_null(strstr(text, "kernel=zephyr.bin"), "config.txt reads as:\n%s", text);
}

/** @brief Every file reads the same a cluster at a time, a block at a time and misaligned. */
ZTEST_F(sdcard_2_bootfs, test_3_files_read_consistently)
{
	zassert_true(fixture->fs.ok);
	for (size_t i = 0; i < fixture->nfiles; i++) {
		uint32_t crc[3] = {0};
		uint64_t t0 = sdq_now_us();

		for (int m = BY_CLUSTER; m <= BY_MISALIGNED; m++) {
			zassert_ok(file_crc(fixture, &fixture->files[i], (enum read_mode)m, &crc[m],
					    NULL, 0),
				   "%s, mode %d", fixture->files[i].name, m);
		}
		TC_PRINT("%-12s %8u bytes  crc32 %08x  (%llu ms for the 3 reads)\n",
			 fixture->files[i].name, fixture->files[i].size, crc[0],
			 ((sdq_now_us() - t0) / 1000U));
		zassert_equal(crc[0], crc[1], "%s: per-block read differs", fixture->files[i].name);
		zassert_equal(crc[0], crc[2], "%s: misaligned read differs",
			      fixture->files[i].name);
	}
}

/** @brief zephyr.bin's CRC-32 matches the one the host wrote (zephyr.crc). */
ZTEST_F(sdcard_2_bootfs, test_4_image_crc_matches_host)
{
	const struct file *bin = find(fixture, "ZEPHYR.BIN");
	const struct file *crcf = find(fixture, "ZEPHYR.CRC");
	char text[16];
	uint32_t crc = 0;
	uint32_t ignored = 0;
	unsigned long want;

	if (crcf == NULL) {
		TC_PRINT("no zephyr.crc on the card (only scripts/sd-qual-test.sh writes it)\n");
		ztest_test_skip();
	}
	zassert_not_null(bin);
	zassert_ok(file_crc(fixture, crcf, BY_CLUSTER, &ignored, text, sizeof(text)));
	want = strtoul(text, NULL, 16);
	zassert_ok(file_crc(fixture, bin, BY_CLUSTER, &crc, NULL, 0));
	zassert_equal(crc, (uint32_t)want, "zephyr.bin crc32 %08x, the host computed %08lx", crc,
		      want);
}

/**
 * @brief 1000 multi-block reads (2-256 blocks) at random places in the
 *        partition's first 1 MB match a block-at-a-time reference copy.
 *
 * Read-only, so it runs on any card. An open-ended multi-block read (CMD18
 * then CMD12) has to stop the card between blocks; this checks that every
 * one ends cleanly and returns the right data.
 */
ZTEST_F(sdcard_2_bootfs, test_5_multi_block_read_stress)
{
	uint32_t base = fixture->fs.ok ? fixture->fs.part_start : 0U;
	uint32_t s = fixture->q->seed ^ 0x510e527fU;
	uint64_t blocks_read = 0;
	uint64_t t0;

	for (uint32_t b = 0; b < SDQ_MAX_BLOCKS; b++) {
		zassert_ok(disk_access_read(SDQ_DISK, &fixture->q->wbuf[(size_t)b * SDQ_BLK],
					    base + b, 1),
			   "reference block %u", (base + b));
	}
	t0 = sdq_now_us();
	for (int i = 0; i < 1000; i++) {
		uint32_t n = 2U + (sdq_rand(&s) % 255U);
		uint32_t first = sdq_rand(&s) % (SDQ_MAX_BLOCKS - n);
		int ret = disk_access_read(SDQ_DISK, fixture->q->rbuf, base + first, n);

		zassert_ok(ret, "read %d (%u+%u) failed (%d) after %d good multi-block reads", i,
			   (base + first), n, ret, i);
		zassert_mem_equal(fixture->q->rbuf, &fixture->q->wbuf[(size_t)first * SDQ_BLK],
				  ((size_t)n * SDQ_BLK), "read %d (%u+%u): wrong data", i,
				  (base + first), n);
		blocks_read += n;
	}
	TC_PRINT("1000 multi-block reads, %llu blocks, %u kB/s\n", blocks_read,
		 sdq_kbps(blocks_read * SDQ_BLK, sdq_now_us() - t0));
}

ZTEST_SUITE(sdcard_2_bootfs, NULL, bootfs_setup, bootfs_before, bootfs_after, NULL);
```

## src/test_4_bounds.c
```c
/*
 * Copyright (c) 2026 Rob McKay
 * SPDX-License-Identifier: Apache-2.0
 *
 * Suite 4: the ends of the card. The last blocks read and write; requests
 * past the end are refused without disturbing the card.
 */

#include <zephyr/storage/disk_access.h>
#include <zephyr/ztest.h>

#include "common.h"

/* The suite's fixture is the shared card (common.h). */
#define sdcard_4_bounds_fixture sdq

/** @brief The first blocks of the card (MBR, partition start) read, twice the same. */
ZTEST_F(sdcard_4_bounds, test_1_first_blocks)
{
	zassert_ok(disk_access_read(SDQ_DISK, fixture->rbuf, 0, 64));
	zassert_ok(disk_access_read(SDQ_DISK, fixture->wbuf, 0, 64));
	zassert_mem_equal(fixture->rbuf, fixture->wbuf, ((size_t)64U * SDQ_BLK),
			  "two reads of blocks 0-63 differ");
}

/** @brief The very last block, and the last 64 blocks, read and write. */
ZTEST_F(sdcard_4_bounds, test_2_last_blocks)
{
	sdq_need_scratch(fixture);
	sdq_write_verify(fixture, fixture->sectors - 1U, 1, 0x40000U);
	sdq_write_verify(fixture, fixture->sectors - 64U, 64, 0x40001U);
}

/** @brief Reads and writes that run past the end are refused (-EINVAL) before reaching the card. */
ZTEST_F(sdcard_4_bounds, test_3_past_the_end_refused)
{
	zassert_equal(disk_access_read(SDQ_DISK, fixture->rbuf, fixture->sectors, 1), -EINVAL,
		      "read of the block after the last");
	zassert_equal(disk_access_read(SDQ_DISK, fixture->rbuf, fixture->sectors - 1U, 2), -EINVAL,
		      "read across the end");
	if (fixture->scratch_ok) {
		zassert_equal(disk_access_write(SDQ_DISK, fixture->wbuf, fixture->sectors - 1U, 2),
			      -EINVAL, "write across the end");
	}
	zassert_ok(disk_access_read(SDQ_DISK, fixture->rbuf, fixture->sectors - 1U, 1),
		   "the last block no longer reads after the refused requests");
}

/**
 * @brief A range whose end wraps past block 0xffffffff is refused (-EINVAL)
 *        before reaching the card.
 *
 * Unpatched, Zephyr's SD stack checks reads and writes with start + count >
 * block_count (subsys/sd/sd_ops.c), which wraps to a small number for
 * block 0xffffffff, so the request goes to the card and only the card's
 * error stops it. zephyr/patches/zephyr/sd-ops-bounds-overflow.patch makes
 * the check overflow-aware, as the erase check already is.
 */
ZTEST_F(sdcard_4_bounds, test_4_wrapping_range_refused)
{
	int ret = disk_access_read(SDQ_DISK, fixture->rbuf, UINT32_MAX, 1);

	zassert_ok(disk_access_read(SDQ_DISK, fixture->rbuf, fixture->sectors - 1U, 1),
		   "the last block no longer reads after a read of block 0xffffffff (%d)", ret);
	zassert_equal(ret, -EINVAL,
		      "read of block 0xffffffff went to the card (%d): the SD stack's bounds "
		      "check wrapped",
		      ret);
}

/** @brief Reading the whole card's address range in 1 MB steps (a block each) works. */
ZTEST_F(sdcard_4_bounds, test_5_whole_range_sampled)
{
	for (uint32_t lba = 0; lba < fixture->sectors; lba += 2048U) {
		zassert_ok(disk_access_read(SDQ_DISK, fixture->rbuf, lba, 1), "block %u", lba);
	}
}

ZTEST_SUITE(sdcard_4_bounds, NULL, sdq_setup, sdq_before, sdq_after, NULL);
```

## src/test_5_erase.c
```c
/*
 * Copyright (c) 2026 Rob McKay
 * SPDX-License-Identifier: Apache-2.0
 *
 * Suite 5: erase (CMD32/33/38). Erased blocks read as all 0x00 or all
 * 0xff (the card chooses), their neighbours keep their data, and a large
 * erase, which keeps the card busy for a long time, completes. Uses the
 * scratch area.
 */

#include <zephyr/storage/disk_access.h>
#include <zephyr/ztest.h>

#include "common.h"

/* The suite's fixture is the shared card (common.h). */
#define sdcard_5_erase_fixture sdq

#define R_SMALL 65536U
#define R_LARGE 81920U
#define LARGE_BLOCKS 16384U /* 8 MB */

BUILD_ASSERT((R_LARGE + LARGE_BLOCKS <= SDQ_SCRATCH_BLOCKS), "scratch area too small");

/**
 * @brief Check that blocks are erased, all to the same value.
 *
 * @param[in,out] q The card and its buffers.
 * @param lba First block.
 * @param blocks Block count, at most SDQ_MAX_BLOCKS.
 * @param[in,out] value The erased value seen so far, or -1 for none yet.
 */
static void expect_erased(struct sdq *q, uint32_t lba, uint32_t blocks, int *value)
{
	zassert_ok(disk_access_read(SDQ_DISK, q->rbuf, lba, blocks));
	for (uint32_t b = 0; b < blocks; b++) {
		const uint8_t *p = &q->rbuf[(size_t)b * SDQ_BLK];

		if (*value < 0) {
			*value = p[0];
		}
		zassert_true(
			((*value == 0x00 || *value == 0xff) && sdq_block_is(p, (uint8_t)*value)),
			"block %u not erased (first byte 0x%02x)", (lba + b), p[0]);
	}
}

/** @brief An 8-block erase in the middle of written data erases exactly those blocks. */
ZTEST_F(sdcard_5_erase, test_1_small_erase_exact)
{
	uint32_t lba = fixture->scratch + R_SMALL;
	int value = -1;

	sdq_need_scratch(fixture);
	sdq_write_verify(fixture, lba, 64, 0x50000U);
	zassert_ok(disk_access_erase(SDQ_DISK, lba + 8U, 8, DISK_ACCESS_ERASE_PHYSICAL));
	expect_erased(fixture, lba + 8U, 8, &value);
	TC_PRINT("erased blocks read as 0x%02x\n", value);
	zassert_ok(disk_access_read(SDQ_DISK, fixture->rbuf, lba, 64));
	zassert_equal(sdq_check(fixture->rbuf, lba, 8, 0x50000U), -1, "blocks before the erase");
	zassert_equal(sdq_check(&fixture->rbuf[(size_t)16U * SDQ_BLK], lba + 16U, 48, 0x50000U), -1,
		      "blocks after the erase");
}

/** @brief A single-block erase, and a write to it afterwards, work. */
ZTEST_F(sdcard_5_erase, test_2_single_block_then_write)
{
	uint32_t lba = fixture->scratch + R_SMALL + 100U;
	int value = -1;

	sdq_need_scratch(fixture);
	sdq_write_verify(fixture, lba, 1, 0x50001U);
	zassert_ok(disk_access_erase(SDQ_DISK, lba, 1, DISK_ACCESS_ERASE_PHYSICAL));
	expect_erased(fixture, lba, 1, &value);
	sdq_write_verify(fixture, lba, 1, 0x50002U);
}

/** @brief An 8 MB erase (long busy on DAT0: review finding 1) completes, and the card works after. */
ZTEST_F(sdcard_5_erase, test_3_large_erase)
{
	uint32_t lba = fixture->scratch + R_LARGE;
	uint64_t t0;
	int value = -1;
	int ret;

	sdq_need_scratch(fixture);
	for (uint32_t b = 0; b < LARGE_BLOCKS; b += SDQ_MAX_BLOCKS) {
		sdq_fill(fixture->wbuf, lba + b, SDQ_MAX_BLOCKS, 0x50003U);
		zassert_ok(disk_access_write(SDQ_DISK, fixture->wbuf, lba + b, SDQ_MAX_BLOCKS));
	}
	t0 = sdq_now_us();
	ret = disk_access_erase(SDQ_DISK, lba, LARGE_BLOCKS, DISK_ACCESS_ERASE_PHYSICAL);
	TC_PRINT("8 MB erase: %d after %llu ms\n", ret, ((sdq_now_us() - t0) / 1000U));
	zassert_ok(ret, "8 MB erase failed: R1b busy wait too short? (review finding 1)");
	for (uint32_t b = 0; b < LARGE_BLOCKS; b += SDQ_MAX_BLOCKS) {
		expect_erased(fixture, lba + b, SDQ_MAX_BLOCKS, &value);
	}
	sdq_write_verify(fixture, lba + LARGE_BLOCKS - 1U, 1, 0x50004U);
}

ZTEST_SUITE(sdcard_5_erase, NULL, sdq_setup, sdq_before, sdq_after, NULL);
```

## src/test_8_recovery.c
```c
/*
 * Copyright (c) 2026 Rob McKay
 * SPDX-License-Identifier: Apache-2.0
 *
 * Suite 8: power cycles and re-initialisation through the disk API, and
 * the card staying usable after a command it doesn't answer.
 */

#include <zephyr/drivers/disk.h>
#include <zephyr/storage/disk_access.h>
#include <zephyr/sys/byteorder.h>
#include <zephyr/ztest.h>

#include "common.h"

/* The suite's fixture is the shared card (common.h). */
#define sdcard_8_recovery_fixture sdq

#define R_RECOVERY 120832U
#define CYCLES     20

BUILD_ASSERT((R_RECOVERY + 64U <= SDQ_SCRATCH_BLOCKS), "scratch area too small");

/** @brief 20 power-off / init cycles: each init succeeds and the data survives. */
ZTEST_F(sdcard_8_recovery, test_1_power_cycles)
{
	uint32_t lba = fixture->scratch + R_RECOVERY;
	uint64_t worst = 0;

	sdq_need_scratch(fixture);
	sdq_write_verify(fixture, lba, 64, 0x80000U);
	for (int i = 0; i < CYCLES; i++) {
		uint64_t t0;
		uint64_t us;

		zassert_ok(disk_access_ioctl(SDQ_DISK, DISK_IOCTL_CTRL_DEINIT, NULL),
			   "cycle %d: power off", i);
		zassert_not_equal(disk_access_status(SDQ_DISK), DISK_STATUS_OK,
				  "cycle %d: status OK while off", i);
		t0 = sdq_now_us();
		zassert_ok(disk_access_ioctl(SDQ_DISK, DISK_IOCTL_CTRL_INIT, NULL),
			   "cycle %d: init", i);
		us = sdq_now_us() - t0;
		worst = MAX(worst, us);
		zassert_equal(disk_access_status(SDQ_DISK), DISK_STATUS_OK, "cycle %d: status", i);
		zassert_ok(disk_access_read(SDQ_DISK, fixture->rbuf, lba, 64), "cycle %d: read", i);
		zassert_equal(sdq_check(fixture->rbuf, lba, 64, 0x80000U), -1, "cycle %d: data", i);
	}
	TC_PRINT("%d power cycles; slowest card init %llu ms\n", CYCLES, (worst / 1000U));
}

/** @brief Writing right after an init, then power-cycling at once, keeps the data. */
ZTEST_F(sdcard_8_recovery, test_2_write_then_power_off)
{
	uint32_t lba = fixture->scratch + R_RECOVERY;

	sdq_need_scratch(fixture);
	for (uint32_t i = 0; i < 5U; i++) {
		sdq_fill(fixture->wbuf, lba, 64, 0x80001U + i);
		zassert_ok(disk_access_write(SDQ_DISK, fixture->wbuf, lba, 64));
		/* DEINIT waits for the card to finish programming first. */
		zassert_ok(disk_access_ioctl(SDQ_DISK, DISK_IOCTL_CTRL_DEINIT, NULL));
		zassert_ok(disk_access_ioctl(SDQ_DISK, DISK_IOCTL_CTRL_INIT, NULL));
		zassert_ok(disk_access_read(SDQ_DISK, fixture->rbuf, lba, 64));
		zassert_equal(sdq_check(fixture->rbuf, lba, 64, 0x80001U + i), -1, "round %u", i);
	}
}

/**
 * @brief The CID ioctl answers or fails cleanly, and the card works after.
 *
 * Zephyr's SD stack reads the CID with CMD2, which a card in transfer state
 * doesn't answer: the command times out. What matters for the driver is
 * that the timeout leaves it usable (review finding 2).
 */
ZTEST_F(sdcard_8_recovery, test_3_unanswered_command)
{
	uint32_t cid[4] = {0};
	int ret = disk_access_ioctl(SDQ_DISK, DISK_IOCTL_GET_CARD_CID, cid);

	if (ret == 0) {
		TC_PRINT("CID: manufacturer 0x%02x, OEM %c%c, product %c%c%c%c%c, rev %u.%u, "
			 "serial %08x, made %u/%u\n",
			 (cid[3] >> 24), (char)(cid[3] >> 16), (char)(cid[3] >> 8), (char)cid[3],
			 (char)(cid[2] >> 24), (char)(cid[2] >> 16), (char)(cid[2] >> 8),
			 (char)cid[2], ((cid[1] >> 28) & 0xfU), ((cid[1] >> 24) & 0xfU),
			 (((cid[1] & 0xffffffU) << 8) | (cid[0] >> 24)), ((cid[0] >> 8) & 0xfU),
			 (2000U + ((cid[0] >> 12) & 0xffU)));
	} else {
		TC_PRINT("CID ioctl: %d (CMD2 is not answered in transfer state)\n", ret);
	}
	zassert_ok(disk_access_read(SDQ_DISK, fixture->rbuf, 0, 8),
		   "the card no longer reads after the CID ioctl (%d): review finding 2", ret);
}

ZTEST_SUITE(sdcard_8_recovery, NULL, sdq_setup, sdq_before, sdq_after, NULL);
```
